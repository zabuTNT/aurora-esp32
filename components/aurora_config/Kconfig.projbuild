## components/aurora_config/Kconfig.projbuild
```kconfig
menu "Aurora ESP32 Configuration"

config WIFI_SSID
    string "Wi-Fi SSID"
    default "MyHomeWiFi"

config WIFI_PASSWORD
    string "Wi-Fi Password"
    default "SuperSecret123"

config INVERTER_IP
    string "Inverter IP"
    default "192.168.0.190"

config INVERTER_PORT
    int "Inverter TCP port"
    range 1 65535
    default 1470

config HTTP_SERVER_PORT
    int "HTTP Server port"
    range 1 65535
    default 8100

endmenu
```
